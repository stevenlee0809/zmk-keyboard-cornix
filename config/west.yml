## config/west.yml
```yaml
manifest:
  remotes:
    - name: zmkfirmware
      url-base: https://github.com/zmkfirmware
    - name: hitsmaxft
      url-base: https://github.com/hitsmaxft
    - name: stevenlee0809
      url-base: https://github.com/stevenlee0809
    - name: urob
      url-base: https://github.com/urob
  projects:
    - name: zmk
      remote: zmkfirmware
      revision: c25e927a2fae915e208a8777ce211a10c658e771
      clone-depth: 1
      import:
        file: app/west.yml
    - name: zmk-helpers
      remote: urob
      revision: main
      clone-depth: 1
    - name: zmk-rgbled-widget
      remote: hitsmaxft
      revision: main
      clone-depth: 1
    - name: zmk-dongle-display
      remote: stevenlee0809
      revision: main
      clone-depth: 1
  self:
    path: config
```
